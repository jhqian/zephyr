## drivers/flash/Kconfig.nxp_qspi_nor
```kconfig
# SPDX-License-Identifier: Apache-2.0

menuconfig NXP_QSPI_NOR
		bool "NXP QSPI NOR Flash"
		select FLASH_HAS_DRIVER_ENABLED
		select USE_QSPI
		select FLASH_HAS_PAGE_LAYOUT
		help
				Enable support for NXP QSPI NOR Flash driver using FlexSPI.
```

## samples/subsys/fs/littlefs/boards/mimxrt1060_evk.conf
```kconfig
#
# Copyright (c) 2020 NXP
#
# SPDX-License-Identifier: Apache-2.0
#

# Need this when storage is on QSPI flash
CONFIG_NXP_QSPI_NOR=y

CONFIG_CODE_FLEXSPI=n
CONFIG_DATA_SEMC=n
CONFIG_CODE_ITCM=y
CONFIG_DATA_DTCM=y
```
